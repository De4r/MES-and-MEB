#include <OneWire.h>
#include <DS18B20.h>

/* 
Program Arduino do odczytu temperatury czujników BD18S20
Wymaga bibliotek DS18B20.h oraz OneWire.h
Adresy pochodzą ze skryptu DS18B20_adresses.ino
Adresy przechowywane w pamięci FLASH
 */

// Numer pinu do którego podłaczasz czujnik
#define ONEWIRE_PIN 10

// Ilość czujników na szynie OneWire
#define SENSORS_NUM 16

// rozdzielczosc - 9, 10, 11, 12 bit
//const byte quality = 12;

// Adresy czujników w pamięci FLASH
const byte address[SENSORS_NUM][8] PROGMEM = {
0x28, 0xC9, 0x6D, 0x5D, 0x4, 0x0, 0x0, 0x31,
0x28, 0xAD, 0xC2, 0x8D, 0x3, 0x0, 0x0, 0x9,
0x28, 0xD5, 0x95, 0x5D, 0x4, 0x0, 0x0, 0x8F,
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0x28, 0xFF, 0x5A, 0xFC, 0x78, 0x18, 0x1, 0xD

};

// Utworzenie obiektu onewire oraz obiektu DS18B20
OneWire onewire(ONEWIRE_PIN);
DS18B20 sensors(&onewire);

void setup() {
  // Otwarcie portu szeregowego
  while(!Serial);
  
  Serial.begin(115200);
//  while(!Serial.available())
  // Inicjalizacja i zażądanie temperatury
//  sensors.begin(quality);
  sensors.begin();
  sensors.request();
}

void loop() {
  if (sensors.available())
  {
    for (byte i=0; i<SENSORS_NUM; i++)
    {
      // Odczyt temperatury
      float temperature = sensors.readTemperature(FA(address[i]));
      // Wypisanie temperatury
      if (i<SENSORS_NUM - 1){
        Serial.print(temperature, 4);
        Serial.print(F(","));
      }
      else{
        Serial.println(temperature, 4);
      }
    }
    // Kolejne zapytanie o temperature
    sensors.request();
  }

}
